## Kconfig.hpm
```kconfig
# Copyright (c) 2026
# SPDX-License-Identifier: Apache-2.0

menu "Hpmicro Zephyr Glue (user)"

rsource "drivers/Kconfig"

endmenu
```

## boards/hpmicro/hpm5361icb/Kconfig
```kconfig
# Copyright 2025 HPMicro
# SPDX-License-Identifier: Apache-2.0

if BOARD_HPM5361ICB

config INIT_EXT_RAM
	bool "Initialize external RAM(SDRAM or DDR)"
	default n

endif
```

## boards/hpmicro/hpm5361icb/Kconfig.hpm5361icb
```kconfig
# Copyright 2025 HPMicro
# SPDX-License-Identifier: Apache-2.0

config BOARD_HPM5361ICB
	select SOC_HPM5361
	select ZEPHYR_HPM_SDK_MODULE
```

## boards/hpmicro/hpm5361icb/board.yml
```yaml
board:
  name: hpm5361icb
  full_name: HPMicro HPM5361 ICB
  vendor: hpmicro
  socs:
    - name: hpm5361
```

## boards/hpmicro/hpm5e31gn1/Kconfig
```kconfig
# Copyright 2025 HPMicro
# SPDX-License-Identifier: Apache-2.0

if BOARD_HPM5E31GN1

config INIT_EXT_RAM
	bool "Initialize external RAM(SDRAM or DDR)"
	default n

endif
```

## boards/hpmicro/hpm5e31gn1/Kconfig.hpm5e31gn1
```kconfig
# Copyright 2025 HPMicro
# SPDX-License-Identifier: Apache-2.0

config BOARD_HPM5E31GN1
	select SOC_HPM5E31
	select ZEPHYR_HPM_SDK_MODULE
```

## boards/hpmicro/hpm5e31gn1/board.yml
```yaml
board:
  name: hpm5e31gn1
  full_name: HPMicro HPM5E31 GN1
  vendor: hpmicro
  socs:
    - name: hpm5e31
```

## boards/hpmicro/hpm5e31gn1/hpm5e31gn1_defconfig
```kconfig
CONFIG_XIP=y
CONFIG_PINCTRL=y
CONFIG_GPIO=y
CONFIG_FLASH=y
CONFIG_DCACHE=n
CONFIG_SOC_ANDES_V5_PMA=n
```

## boards/hpmicro/uhpm6e00evk/Kconfig.uhpm6e00evk
```kconfig
# Copyright (c) 2025 HPMicro
# SPDX-License-Identifier: Apache-2.0

config BOARD_UHPM6E00EVK
	select SOC_HPM6E80
```

## boards/hpmicro/uhpm6e00evk/board.yml
```yaml
board:
  name: uhpm6e00evk
  full_name: HPMicro HPM6E00EVK (user)
  vendor: hpmicro
  socs:
    - name: hpm6e80
```

## drivers/ethercat/Kconfig
```kconfig
# Copyright (c) 2026
# SPDX-License-Identifier: Apache-2.0

# 厂商 C 代码，由 zephyr_user/drivers/Kconfig 的 DUST_ECAT_HAL_HPM select。

# HPMicro 片内 ESC 设备驱动（esc_hpmicro.c）
config HPM_ESC
    bool "HPMicro on-chip EtherCAT slave controller"
    default n
    depends on DT_HAS_HPMICRO_HPM_ESC_ENABLED
    help
      HPMicro 片内 ESC 的 Zephyr 设备驱动：寄存器读写、MDIO、中断、PHY 复位、
      EEPROM 模式配置。由 DUST_ECAT_HAL_HPM 或业务门禁 select。

# PDRAM 区按 32 位整字访问（SM2/SM3 过程数据搬运）
config HPM_ESC_PDRAM_WORD_ACCESS
    bool "Access ESC PDRAM with 32-bit words"
    default n
    depends on HPM_ESC
    help
      PDRAM 区（0x1000~0x10000）地址与长度均 4 字节对齐时改用 32 位整字
      读写，逐字节访问慢约 4 倍。过程数据搬运必须打开。
```

## dts/bindings/clock/hpmicro,hpm-pllv2.yaml
```yaml
# Copyright (c) 2025 HPMicro
# SPDX-License-Identifier: Apache-2.0

description: HPMicro PLL v2

compatible: "hpmicro,hpm-pllv2"

include: [clock-controller.yaml, base.yaml]

properties:
  reg:
    required: true

  clock-frequency:
    required: false
    type: int
    description: PLL output frequency

  "#clock-cells":
    const: 3

clock-cells:
  - name
  - src
  - div
```

## dts/bindings/ethercat/hpmicro,ecat-phy-jl1111.yaml
```yaml
# SPDX-License-Identifier: Apache-2.0

description: |
  JL1111 100BASE-TX EtherCAT PHY.

  板卡 dts 写法：
    ecat_phy0: ethercat-phy@0 {
        compatible = "hpmicro,ecat-phy-jl1111";
        mdio-address = <0>;
        phy-mode = "mii";
        autoneg;
        advertise = <0x0100>;
    };

compatible: "hpmicro,ecat-phy-jl1111"

include: "hpmicro,ecat-phy.yaml"
```

## dts/bindings/ethercat/hpmicro,ecat-phy-rtl8201f.yaml
```yaml
# SPDX-License-Identifier: Apache-2.0

description: |
  RTL8201F 100BASE-TX EtherCAT PHY.

  板卡 dts 写法：
    ecat_phy0: ethercat-phy@1 {
        compatible = "hpmicro,ecat-phy-rtl8201f";
        mdio-address = <1>;
        phy-mode = "mii";
        autoneg;
        advertise = <0x0100>;
    };

compatible: "hpmicro,ecat-phy-rtl8201f"

include: "hpmicro,ecat-phy.yaml"

properties:
  eee-enable:
    type: boolean
    description: |
      Keep the PHY's EEE (Energy Efficient Ethernet) capability enabled.
      Default off: EtherCAT requires a continuous MII clock, so the driver
      disables EEE unless this property is present.
```

## dts/bindings/ethercat/hpmicro,ecat-phy-tja1101b.yaml
```yaml
# SPDX-License-Identifier: Apache-2.0

description: |
  TJA1101B 100BASE-T1 EtherCAT PHY (automotive single-pair Ethernet).

  板卡 dts 写法：
    ecat_phy1: ethercat-phy@0 {
        compatible = "hpmicro,ecat-phy-tja1101b";
        mdio-address = <0>;
        phy-mode = "mii";
        master-slave = "auto";
    };

compatible: "hpmicro,ecat-phy-tja1101b"

include: "hpmicro,ecat-phy.yaml"

properties:
  master-slave:
    type: string
    enum:
      - "auto"
      - "master"
      - "slave"
    default: "auto"
    description: |
      100BASE-T1 master/slave role. "auto" leaves the reset default
      (auto-negotiated with the link partner).
```

## dts/bindings/ethercat/hpmicro,ecat-phy.yaml
```yaml
# SPDX-License-Identifier: Apache-2.0

description: |
  EtherCAT PHY attached to the HPMicro ESC MDIO bus.

  PHY 驱动的全部可配项都在这里声明，板卡只在 dts 里填值。
  各芯片的 binding 继承本文件，只追加自己的私有属性。

compatible: "hpmicro,ecat-phy"

include: base.yaml

properties:
  mdio-address:
    type: int
    required: true
    description: PHY address on the ESC MDIO bus

  phy-mode:
    type: string
    enum:
      - "mii"
      - "rmii"
      - "rgmii"
    default: "mii"
    description: Host interface mode between ESC and this PHY

  autoneg:
    type: boolean
    description: |
      Enable auto-negotiation. When absent, the PHY is forced to
      `speed` / `duplex` instead.

  advertise:
    type: int
    default: 0x0100
    description: |
      Clause-22 ANAR advertisement bits, only meaningful with `autoneg`.
      bit8 = 100BASE-TX full duplex, bit7 = 100BASE-TX half,
      bit6 = 10BASE-T full, bit5 = 10BASE-T half, bit0 = 802.3 selector.

  speed:
    type: string
    enum:
      - "10"
      - "100"
      - "1000"
    default: "100"
    description: Forced speed, only used when `autoneg` is absent

  duplex:
    type: string
    enum:
      - "half"
      - "full"
    default: "full"
    description: Forced duplex, only used when `autoneg` is absent

  led-mode:
    type: int
    default: 0
    description: Chip-private LED mode value (0 = driver default)
```

## soc/hpmicro/HPM5300/Kconfig.soc
```kconfig
# Copyright (c) 2025 HPMicro
# SPDX-License-Identifier: Apache-2.0

config SOC_SERIES_HPM5300
	bool
	select SOC_FAMILY_HPM
	select HAS_HPMSDK_PLLCTLV2
	select HAS_HPMSDK_PCFG

config SOC_SERIES
	default "HPM5300" if SOC_SERIES_HPM5300

config SOC_HPM5361
	bool
	select SOC_SERIES_HPM5300

config SOC
	default "HPM5361" if SOC_HPM5361
```
